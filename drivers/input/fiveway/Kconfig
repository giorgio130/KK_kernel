## drivers/input/fiveway/Kconfig
```kconfig
#
# 5-Way Switch driver configuration
#
config INPUT_FIVEWAY
	tristate "5-Way Switch"
	depends on INPUT
	help
	  Say Y here if you have a 5-Way switch connected to your system.

	  If unsure, say N.

	  To compile this driver as a module, choose M here: the
	  module will be called fiveway.
```

## drivers/input/volume/Kconfig
```kconfig
#
# Volume keys driver configuration
#
config INPUT_VOLUME
	tristate "Volume Keys"
	depends on INPUT
	help
	  Say Y here if you have volume keys connected to your system.

	  If unsure, say N.

	  To compile this driver as a module, choose M here: the
	  module will be called volume.
```

## drivers/net/wireless/ath6k/Kconfig
```kconfig
#
# Atheros WiFi driver
#
config ATHEROS_AR6000
	tristate "Atheros AR6000 driver"
	#depends on INPUT
	help
	  Say Y here if you have an Atheros WiFi chip in your system

	  If unsure, say N.

	  To compile this driver as a module, choose M here: the
	  module will be called ar6000.
```

## sound/soc/imx/Kconfig
```kconfig
config SND_MXC_SOC
 tristate "SoC Audio for the Freescale i.MX CPU"
 depends on ARCH_MXC && SND
 select SND_PCM
 help
   Say Y or M if you want to add support for codecs attached to
   the MXC I2S or SSP interface. You will also need
   to select the audio interfaces to support below.

config SND_MXC_SOC_SSI
 tristate

config SND_MXC_SOC_ESAI
 tristate

config SND_MXC_SOC_IRAM
 bool "Locate Audio DMA playback buffers in IRAM"
 help 
   Say Y if you don't want Audio playback buffers in external ram
 
config SND_SOC_IMX_3STACK_WM8350
 tristate "SoC Audio support for IMX - WM8350"
 select SND_MXC_SOC_SSI
 select SND_SOC_WM8350
 select REGULATOR_WM8350
 help
   Say Y if you want to add support for SoC audio on IMX 3STACK
   with the WM8350.

config SND_SOC_IMX_3STACK_AK4647
 tristate "SoC Audio support for IMX - AK4647"
 select SND_MXC_SOC_SSI
 select SND_SOC_AK4647
 help
   Say Y if you want to add support for SoC audio on IMX 3STACK
   with the AK4647.

config SND_SOC_IMX_3STACK_WM8580
 tristate "SoC Audio support for IMX - WM8580"
 select SND_MXC_SOC_ESAI
 select SND_SOC_WM8580
 help
   Say Y if you want to add support for Soc audio on IMX 3STACK
   with the WM8580

config SND_SOC_IMX_3STACK_WM8903
 tristate "SoC Audio support for IMX - WM8903"
 select SND_MXC_SOC_SSI
 select SND_SOC_WM8903
 help
   Say Y if you want to add support for Soc audio on IMX 3STACK
   with the WM8903

config SND_SOC_MX35LUIGI_WM8960
 tristate "SoC Audio support for MX35 - WM8960"
 depends on SND_MXC_SOC && ARCH_MX35
 select SND_MXC_SOC_SSI
 select SND_SOC_WM8960
 help

config SND_SOC_IMX_3STACK_SGTL5000
 tristate "SoC Audio support for IMX - SGTL5000"
 select SND_MXC_SOC_SSI
 select SND_SOC_SGTL5000
 help
   Say Y if you want to add support for SoC audio on IMX 3STACK
   with the SGTL5000.

config SND_SOC_IMX_3STACK_BLUETOOTH
 tristate "SoC Audio support for IMX - BLUETOOTH"
 select SND_MXC_SOC_SSI
 select SND_SOC_BLUETOOTH
 help
   Say Y if you want to add support for SoC audio on IMX 3STACK
   with the BLUETOOTH.

config SND_SOC_IMX_NO_DMA
  "tristate "Support for Non-DMA mode"
  select SND_MXC_SOC_SSI
  help
    This option is useful when DMA cannot be used for the Audio 
    buffers. This option enables the use of SSI PIO mode using 
    Fast Interrupts or FIQ. An FIQ is a higher priority interrupt
    request
```
